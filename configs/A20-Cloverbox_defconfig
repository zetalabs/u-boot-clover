## configs/A20-Cloverbox_defconfig
```kconfig
CONFIG_ARM=y
CONFIG_ARCH_SUNXI=y
CONFIG_MACH_SUN7I=y
CONFIG_DRAM_CLK=432
CONFIG_MMC0_CD_PIN="PH6"
CONFIG_USB0_VBUS_PIN="PB9"
CONFIG_USB0_VBUS_DET="AXP0-VBUS-DETECT"
CONFIG_USB0_ID_DET="PH4"
CONFIG_USB1_VBUS_PIN=""
CONFIG_USB2_VBUS_PIN=""
CONFIG_I2C0_ENABLE=y
CONFIG_I2C1_ENABLE=y
CONFIG_I2C2_ENABLE=y
CONFIG_AXP_GPIO=y
# CONFIG_VIDEO_HDMI is not set
# CONFIG_VIDEO_VGA is not set
# CONFIG_VIDEO_COMPOSITE is not set
CONFIG_VIDEO_LCD_MODE="x:800,y:480,depth:24,pclk_khz:33000,le:87,ri:40,up:31,lo:13,hs:1,vs:1,sync:3,vmode:0"
CONFIG_VIDEO_LCD_DCLK_PHASE=0
CONFIG_VIDEO_LCD_POWER="PH1"
CONFIG_VIDEO_LCD_RESET="PH11"
CONFIG_VIDEO_LCD_BL_EN="PH0"
CONFIG_VIDEO_LCD_BL_PWM="PB2"
CONFIG_USB_MUSB_HOST=y
CONFIG_DEFAULT_DEVICE_TREE="sun7i-a20-cloverbox"
CONFIG_SYS_MALLOC_CLEAR_ON_INIT=y
CONFIG_SPL=y
CONFIG_SYS_EXTRA_OPTIONS="AXP209_POWER,SUNXI_EMAC,MACPWR=SUNXI_GPA(17)"
# CONFIG_CMD_IMLS is not set
# CONFIG_CMD_FLASH is not set
# CONFIG_CMD_FPGA is not set
CONFIG_USB_EHCI_HCD=y
# CONFIG_NETDEVICES is not set
# CONFIG_SPL_OF_CONTROL is not set
# CONFIG_OF_SEPARATE is not set
CONFIG_OF_EMBED=y
CONFIG_OLD_SUNXI_KERNEL_COMPAT=y
```
